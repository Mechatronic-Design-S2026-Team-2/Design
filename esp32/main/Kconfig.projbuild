## klann-esp32/main/Kconfig.projbuild
```kconfig
menu "micro-ROS example-app settings"

    config MICRO_ROS_APP_STACK
        int "Stack the micro-ROS app (Bytes)"
        default 16000
        help
            Stack size in Bytes of the micro-ROS app

    config MICRO_ROS_APP_TASK_PRIO
        int "Priority of the micro-ROS app"
        default 5
        help
            Priority of micro-ROS task. Higher value means higher priority.

    config MICROROS_UART_TXD
        int "micro-ROS UART TX GPIO"
        default 1
        help
            UART TX pin for custom micro-ROS serial transport.

    config MICROROS_UART_RXD
        int "micro-ROS UART RX GPIO"
        default 3
        help
            UART RX pin for custom micro-ROS serial transport.

    config MICROROS_UART_RTS
        int "micro-ROS UART RTS GPIO"
        default -1
        help
            UART RTS pin for custom micro-ROS serial transport.
            Use -1 when unused.

    config MICROROS_UART_CTS
        int "micro-ROS UART CTS GPIO"
        default -1
        help
            UART CTS pin for custom micro-ROS serial transport.
            Use -1 when unused.

endmenu
```
